## CMakeLists.txt
```
cmake_minimum_required(VERSION 3.20.0)
find_package(Zephyr)
project(opetusdemo)

target_sources(app PRIVATE src/main.c src/gpio.s)
```

## prj.conf
```kconfig
CONFIG_DEBUG_OPTIMIZATIONS=y
CONFIG_CORTEX_M_DWT=y
CONFIG_CORTEX_M_DEBUG_MONITOR_HOOK=y
```

## src/main.c
```c
#include <zephyr/kernel.h>

#define LED_PIN 28

extern void configure_gpio_out(unsigned int pin);
extern void write_gpio_hi(unsigned int pin);
extern void write_gpio_lo(unsigned int pin);


int main(){
    bool ledState = false;
    configure_gpio_out(LED_PIN);

    for(;;){
        if(ledState){
            // asettaa ledin pois päältä
            write_gpio_hi(LED_PIN);
            ledState = !ledState;
        }else{
            // asettaa ledin päälle
            write_gpio_lo(LED_PIN);
            ledState = !ledState;
        }

        k_msleep(200);

    }

}
```
